## block/Kconfig.iosched
```kconfig
# SPDX-License-Identifier: GPL-2.0
if BLOCK

menu "IO Schedulers"

config IOSCHED_NOOP
	bool
	default y
	help
	  The no-op I/O scheduler is a minimal scheduler that does basic merging
	  and sorting. Its main uses include non-disk based block devices like
	  memory devices, and specialised software or hardware environments
	  that do their own scheduling and require only minimal assistance from
	  the kernel.

config IOSCHED_DEADLINE
	tristate "Deadline I/O scheduler"
	default y
	help
	  The deadline I/O scheduler is simple and compact. It will provide
	  CSCAN service with FIFO expiration of requests, switching to
	  a new point in the service tree and doing a batch of IO from there
	  in case of expiry.

config IOSCHED_CFQ
	tristate "CFQ I/O scheduler"
	default y
	help
	  The CFQ I/O scheduler tries to distribute bandwidth equally
	  among all processes in the system. It should provide a fair
	  and low latency working environment, suitable for both desktop
	  and server systems.

	  This is the default I/O scheduler.

config CFQ_GROUP_IOSCHED
	bool "CFQ Group Scheduling support"
	depends on IOSCHED_CFQ && BLK_CGROUP
	default n
	help
	  Enable group IO scheduling in CFQ.

choice

	prompt "Default I/O scheduler"
	default DEFAULT_ADIOS
	help
	  Select the I/O scheduler which will be used by default for all
	  block devices.

	config DEFAULT_DEADLINE
		bool "Deadline" if IOSCHED_DEADLINE=y

	config DEFAULT_CFQ
		bool "CFQ" if IOSCHED_CFQ=y

	config DEFAULT_NOOP
		bool "No-op"

	config DEFAULT_ADIOS
		bool "ADIOS" if IOSCHED_ADIOS=y

	config DEFAULT_SSG
		bool "SSG" if MQ_IOSCHED_SSG=y

endchoice

config DEFAULT_IOSCHED
	string
	default "deadline" if DEFAULT_DEADLINE
	default "cfq" if DEFAULT_CFQ
	default "noop" if DEFAULT_NOOP
	default "adios" if DEFAULT_ADIOS
	default "ssg" if DEFAULT_SSG

config MQ_IOSCHED_DEADLINE
	tristate "MQ deadline I/O scheduler"
	default y
	help
	  MQ version of the deadline IO scheduler.

config IOSCHED_ADIOS
	tristate "ADIOS I/O scheduler"
	default y
	help
	  Adaptive Deadline I/O Scheduler (ADIOS) for blk-mq. It learns
	  device I/O latency and uses adaptive deadlines and request batching.
	  The scheduler can be selected at runtime through the block queue's
	  scheduler sysfs attribute.

config MQ_IOSCHED_SSG
	tristate "Samsung Generic I/O scheduler"
	default y
	help
	  Samsung Generic I/O scheduler (SSG) adapted to this kernel's
	  Linux 4.19 blk-mq elevator API. Includes deadline/sector ordering
	  and asynchronous-write depth control. Cgroup and vendor statistics
	  extensions are intentionally excluded from this initial port.

endmenu

endif
```

## drivers/block/zram/Kconfig
```kconfig
# SPDX-License-Identifier: GPL-2.0
config ZRAM
	tristate "Compressed RAM block device support"
	depends on BLOCK && SYSFS && ZSMALLOC && CRYPTO
	select CRYPTO_LZO
	default n
	help
	  Creates virtual block devices called /dev/zramX (X = 0, 1, ...).
	  Pages written to these disks are compressed and stored in memory
	  itself. These disks allow very fast I/O and compression provides
	  good amounts of memory savings.

	  It has several use cases, for example: /tmp storage, use as swap
	  disks and maybe many more.

	  See Documentation/blockdev/zram.txt for more information.

config ZRAM_WRITEBACK
       bool "Write back incompressible or idle page to backing device"
       depends on ZRAM
       default n
       help
	 With incompressible page, there is no memory saving to keep it
	 in memory. Instead, write it out to backing device.
	 For this feature, admin should set up backing device via
	 /sys/block/zramX/backing_dev.

	 With /sys/block/zramX/{idle,writeback}, application could ask
	 idle page's writeback to the backing device to save in memory.

	 See Documentation/blockdev/zram.txt for more information.

config ZRAM_MEMORY_TRACKING
	bool "Track zRam block status"
	depends on ZRAM && DEBUG_FS
	help
	  With this feature, admin can track the state of allocated blocks
	  of zRAM. Admin could see the information via
	  /sys/kernel/debug/zram/zramX/block_state.

	  See Documentation/blockdev/zram.txt for more information.

config ZRAM_MULTI_COMP
	bool "Enable multiple compression streams"
	depends on ZRAM && 64BIT
	help
	  Enable secondary compression algorithms and manual page recompression.
	  This can improve memory savings for huge or idle pages at the cost of
	  additional CPU time. Idle pages can be marked through the zram idle
	  attribute; CONFIG_ZRAM_MEMORY_TRACKING additionally exposes timestamps.

config ZRAM_AUTO_RECOMP
	bool "Automatically recompress cold ZRAM pages"
	depends on ZRAM && ZRAM_MULTI_COMP
	default n
	help
	  Periodically recompress cold zram slots using the configured secondary
	  compression algorithms. A slot is marked as a candidate and is only
	  recompressed on a later pass if it has not been accessed in between.
	  The worker uses bounded scans and a bounded recompression batch. Manual
	  recompression remains available independently of this option.

config ZRAM_AUTO_RECOMP_ALGORITHM
	string "Default secondary ZRAM compression algorithm"
	depends on ZRAM_AUTO_RECOMP
	default "zstd"
	help
	  Secondary compressor used by automatic cold-page recompression.
	  The primary compressor remains unchanged. The selected algorithm must
	  be enabled in the kernel Crypto API. Leave empty to disable the default
	  secondary compressor and configure one through recomp_algorithm instead.

config ZRAM_AUTO_RECOMP_INTERVAL
	int "Seconds between automatic ZRAM recompression passes"
	depends on ZRAM_AUTO_RECOMP
	range 30 3600
	default 120
	help
	  Delay between background passes. A page must remain untouched between
	  candidate marking and a later processing pass to be eligible.

config ZRAM_AUTO_RECOMP_PAGES
	int "ZRAM slots per automatic mark/process window"
	depends on ZRAM_AUTO_RECOMP
	range 256 65536
	default 16384
	help
	  Maximum number of zram slots scanned by each mark/process pass.

config ZRAM_AUTO_RECOMP_MAX_PAGES
	int "Maximum automatic recompressions per pass"
	depends on ZRAM_AUTO_RECOMP
	range 16 4096
	default 256
	help
	  Limit candidate recompressions in one pass to keep background CPU and
	  memory-allocation work bounded.
```

## mm/damon/Kconfig
```kconfig
# SPDX-License-Identifier: GPL-2.0-only
#
# DAMON components backported for the Hysteris Linux 4.19.325 tree.
# Physical-address monitoring is sufficient for proactive reclaim and
# LRU sorting; virtual-address and sysfs interfaces are intentionally
# excluded from this first port.

menu "Data Access Monitoring"

config DAMON
	bool "DAMON: Data Access Monitoring Framework"
	help
	  This builds the Data Access MONitor framework.  It samples memory
	  access activity and exposes region-level access/age information to
	  kernel policies.

config DAMON_PADDR
	bool "DAMON physical address monitoring operations"
	depends on DAMON && MMU && MIGRATION
	select IDLE_PAGE_TRACKING
	default DAMON
	help
	  Build physical-address monitoring using page-table young bits,
	  idle-page tracking, and reverse mapping.  This is the backend used
	  by DAMON_RECLAIM and DAMON_LRU_SORT.

config DAMON_RECLAIM
	bool "DAMON-based proactive page reclaim"
	depends on DAMON_PADDR
	help
	  Reclaim cold physical memory proactively under bounded time and
	  page-out quotas.  The normal split-LRU reclaimer remains responsible
	  for allocation-time and heavy-pressure reclaim.  Disabled by default
	  at runtime; enable through damon_reclaim.enabled.

config DAMON_LRU_SORT
	bool "DAMON-based hot/cold LRU sorting"
	depends on DAMON_PADDR
	help
	  Protect hot pages and deactivate cold pages using DAMON access
	  observations.  Hysteris provides the generic deactivate_page()
	  helper, so both hot and cold actions are implemented for anon and
	  file-backed pages.  Disabled by default at runtime; enable through
	  damon_lru_sort.enabled.

endmenu
```
